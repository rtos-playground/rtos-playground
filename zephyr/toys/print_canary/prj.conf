## CMakeLists.txt
```
cmake_minimum_required(VERSION 3.13.1)
include($ENV{ZEPHYR_BASE}/cmake/app/boilerplate.cmake NO_POLICY_SCOPE)
project(print_canary)

target_sources(app PRIVATE src/main.c)
```

## prj.conf
```kconfig
CONFIG_CONSOLE_SUBSYS=y
CONFIG_CONSOLE_GETLINE=y
CONFIG_STACK_CANARIES=y
CONFIG_TEST_RANDOM_GENERATOR=y
```

## src/main.c
```c
#include <string.h>
#include <zephyr.h>
#include <misc/printk.h>
#include <console.h>

extern void **__stack_chk_guard;

void vuln(void) {
	char stack_buf[32];
	printk("[bof] > ");
	strcpy(stack_buf, console_getline());
}

void main(void)
{
	console_getline_init();

	printk("System running\n");
	printk("Canary is %p\n", __stack_chk_guard);

	for(;;) {
		vuln();
	}
}
```
